## zmkFirmware/zmk-config/config/boards/shields/vanana/Kconfig.defconfig
```kconfig
# Copyright (c) 2020 dELLIKEEb
# SPDX-License-Identifier: MIT

if SHIELD_VANANA_REV2

config ZMK_KEYBOARD_NAME
	default "Vanana rev2"

endif
```

## zmkFirmware/zmk-config/config/boards/shields/vanana/Kconfig.shield
```kconfig
# Copyright (c) 2020 dELLIKEEb
# SPDX-License-Identifier: MIT

config SHIELD_VANANA_REV2
	def_bool $(shields_list_contains, waaffle_rev3)
```

## zmkFirmware/zmk-config/config/boards/shields/waaffle/Kconfig.defconfig
```kconfig
# Copyright (c) 2020 dELLIKEEb
# SPDX-License-Identifier: MIT

if SHIELD_WAAFFLE_REV3

config ZMK_KEYBOARD_NAME
	default "Waaffle rev3"

endif
```

## zmkFirmware/zmk-config/config/boards/shields/waaffle/Kconfig.shield
```kconfig
# Copyright (c) 2020 dELLIKEEb
# SPDX-License-Identifier: MIT

config SHIELD_WAAFFLE
	def_bool $(shields_list_contains, waaffle)

config SHIELD_WAAFFLE_REV3
	def_bool $(shields_list_contains, waaffle_rev3)
```
